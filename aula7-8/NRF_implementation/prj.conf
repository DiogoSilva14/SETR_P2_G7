## CMakeLists.txt
```
# SPDX-License-Identifier: Apache-2.0

cmake_minimum_required(VERSION 3.20.0)

find_package(Zephyr REQUIRED HINTS $ENV{ZEPHYR_BASE})
project(vending_machine)

include_directories(
    ${PROJECT_SOURCE_DIR}/include
    )

target_sources(app PRIVATE src/device_drivers.c src/start_vending_machine.c src/state_machine.c src/vending_machine.c)
```

## prj.conf
```kconfig
# nothing here

CONFIG_NEWLIB_LIBC_FLOAT_PRINTF=y
```

## include/device_drivers.h
```c
/** @file device_drivers.h
 * @brief
 *
 * Device drivers for vending machine project
 * 
 * @date 03 May 2022
 * @bug No known bugs.
 */

#ifndef DEVICE_DRIVERS_H
#define DEVICE_DRIVERS_H

#include <stdio.h>
#include <stdint.h>
#include <string.h>
#ifdef __linux__
    #include <pthread.h>
    #include <unistd.h>
    #include <pthread.h>
#else
    #include <zephyr.h>
    #include <sys/printk.h>
    #include <device.h>
#endif

// Enum the possible events
enum EVENTS{NONE, EVENT_COIN, EVENT_RETURN, EVENT_ARROW, EVENT_SELECT};

// Enum the buttons for selection of products
enum DIRECTION{UP, DOWN};

/** @brief Initialize device drivers (GPIOs in the case of uC, etc)
 *  @return 0 if successful
 *          -1 indicates initializing failure
 */

uint8_t init_drivers();

/** @brief Changes the passed pointer value to the last event
 *  @param event_pointer pointer to the local to store the last event
 */

void get_last_event(uint8_t* event_pointer);

/** @brief Returns the value of the last arrow pressed (UP or DOWN)
 *  @return unsigned 8-bit integer with value equal to UP or DOWN
 */

uint8_t get_arrow_val();

/** @brief Prints passed string to the screen
 *  @param string String to be printed
 */

void print(char* string);

/** @brief Makes the device sleep for X miliseconds
 *  @param ms Amount of milliseconds for the device to sleep
 */

void device_sleep(uint32_t ms);

/** @brief Returns the value of the last coin inserted
 *  @return value of the coin inserted as a float
 */

float get_coin_val();

#endif
```

## include/state_machine.h
```c
/** @file state_machine.h
 * @brief state_machine.h header file brief description
 *
 * State machine state machine implementation header file
 * 
 * @date 10 May 2022
 * @bug No known bugs.
 */

#ifndef STATE_MACHINE_H
#define STATE_MACHINE_H

#include <stdio.h>
#include <stdint.h>
#include "vending_machine.h"
#include "device_drivers.h"

// Enum the states of the state machine
enum STATES{STATE_DISPLAY, STATE_RETURN_MONEY, STATE_COIN_INSERTED, STATE_DISPENSE_PRODUCT, STATE_ERROR_MESSAGE, STATE_CHANGE_PRODUCT};

/** @brief Initialize the state machine
 *  @return 0 if successful
 *          -1 indicates initializing failure
 */
uint8_t init_sm();

/** @brief State machine loop function
 */

void sm_loop();

#endif
```

## include/vending_machine.h
```c
/** @file vending_machine.h
 * @brief vending_machine.h header file brief description
 *
 * Vending machine state machine implementation header file
 * 
 * @date 03 May 2022
 * @bug No known bugs.
 */

#ifndef VENDING_MACHINE_H
#define VENDING_MACHINE_H

#include <stdio.h>
#include <stdint.h>
#include "device_drivers.h"

// Enum the products available in the vending machine
// Always leave the NUM_PRODUCTS as the last value, so that you can easily
// know the number of the products in the enum
enum products{BEER, TUNA_SANDWICH, COFFEE, NUM_PRODUCTS};

// Price of products, same order as the enum
static float prices[] = {1.5, 1.0, 0.5};

/** @brief Returns the currently selected product index
 *  @return Index of the product as an unsigned 8bit integer
 */

uint8_t get_curr_product();

/** @brief Set the new current product index
 *  @param new_prod New selected product index
 */

void set_curr_product(uint8_t new_prod);

/** @brief Returns the value of the currently selected value
 *  @return Value of the product as a float
 */

float get_prod_val();

/** @brief Returns the amount of money the user has available
 *  @return User's money as a float
 */

float get_user_money();

/** @brief Set a new value for the user's money
 *  @param new_val New value for the user's money
 */
void set_user_money(float new_val);

/** @brief Dispenses the selected product
 */

void dispense_prod();

/** @brief Cycles the displayed product up or down
 */

void cycle_prod();

/** @brief Returns the money the user has inserted
 */

void return_money();

/** @brief Displays error message when the user doesn't have enough money
 */

void error_msg();

/** @brief Displays the selected product, its cost and the user money
 */

void display_product_money();

/** @brief Handle a coin being inserted
 */

void coin_inserted();

#endif
```

## src/device_drivers.c
```c
/** @file device_drivers.c
 * @brief
 *
 * Device drivers for vending machine project
 * 
 * @date 03 May 2022
 * @bug No known bugs.
 */

#include "device_drivers.h"
#include <zephyr.h>
#include <sys/printk.h>
#include <devicetree.h>
#include <device.h>
#include <drivers/gpio.h>
#include <stdio.h>

#define GPIO0_NID DT_NODELABEL(gpio0)

#define LED1 0xD
#define LED2 0xE
#define LED3 0xF
#define LED4 0x10

#define BUT_Ext1 0x4
#define BUT_Ext2 28
#define BUT_Ext3 29
#define BUT_Ext4 30

#define BUT1 11
#define BUT2 12
#define BUT3 24
#define BUT4 25

static struct gpio_callback button_cb_data1;
static struct gpio_callback button_cb_data2;
static struct gpio_callback button_cb_data3;
static struct gpio_callback button_cb_data4;


static struct gpio_callback button_board_data1;
static struct gpio_callback button_board_data2;
static struct gpio_callback button_board_data3;
static struct gpio_callback button_board_data4;

static uint8_t button_dir = 0;
static uint8_t event = NONE;
static float coin = 0;



void pressed_button1(const struct device *dev, struct gpio_callback *cb, uint32_t pins)
{
    float temp=1.232;
    printf("\n %.1f \n",temp);
    gpio_pin_toggle(dev, LED1);
	event = EVENT_COIN;
    coin = 0.1;
}


void pressed_button2(const struct device *dev, struct gpio_callback *cb, uint32_t pins)
{
	event = EVENT_COIN;
    coin = 0.2;
}

void pressed_button3(const struct device *dev, struct gpio_callback *cb, uint32_t pins)
{
	event = EVENT_COIN;
    coin = 0.5;
}


void pressed_button4(const struct device *dev, struct gpio_callback *cb, uint32_t pins)
{
	event = EVENT_COIN;
    coin = 1;
}


void pressed_board_1(const struct device *dev, struct gpio_callback *cb, uint32_t pins)
{
	event = EVENT_ARROW;
    button_dir = UP;
}

void pressed_board_2(const struct device *dev, struct gpio_callback *cb, uint32_t pins)
{
	event = EVENT_RETURN;
}


void pressed_board_3(const struct device *dev, struct gpio_callback *cb, uint32_t pins)
{
	event = EVENT_ARROW;
    button_dir = DOWN;
}

void pressed_board_4(const struct device *dev, struct gpio_callback *cb, uint32_t pins)
{
    event = EVENT_SELECT;
}

uint8_t init_drivers(){
    
    const struct device *dev;
	int ret;

	dev = device_get_binding(DT_LABEL(GPIO0_NID));  

    ret = gpio_pin_configure(dev, BUT_Ext1, GPIO_INPUT | GPIO_PULL_UP);
	if (ret < 0) {
		return -1;
	}

    ret = gpio_pin_configure(dev, LED1, GPIO_OUTPUT_ACTIVE);
	if (ret < 0) {
		return -1;
	}

	ret = gpio_pin_configure(dev, BUT_Ext2, GPIO_INPUT | GPIO_PULL_UP);
	if (ret < 0) {
		return -1;
	}

	ret = gpio_pin_configure(dev, BUT_Ext3, GPIO_INPUT | GPIO_PULL_UP);
	if (ret < 0) {
		return -1;
	}

	ret = gpio_pin_configure(dev, BUT_Ext4, GPIO_INPUT | GPIO_PULL_UP);
	if (ret < 0) {
		return -1;
	}

	ret = gpio_pin_configure(dev, BUT1, GPIO_INPUT | GPIO_PULL_UP);
	if (ret < 0) {
		return -1;
	}

	ret = gpio_pin_configure(dev, BUT2, GPIO_INPUT | GPIO_PULL_UP);
	if (ret < 0) {
		return -1;
	}

	ret = gpio_pin_configure(dev, BUT3, GPIO_INPUT | GPIO_PULL_UP);
	if (ret < 0) {
		return -1;
	}


	ret = gpio_pin_configure(dev, BUT4, GPIO_INPUT | GPIO_PULL_UP);
	if (ret < 0) {
		return -1;
	}

    /*Extern Button1*/
    ret = gpio_pin_interrupt_configure(dev, BUT_Ext1, GPIO_INT_EDGE_TO_ACTIVE | GPIO_INT_DEBOUNCE);

	/*Initialize the static struct gpio_callback variable   */
	gpio_init_callback(&button_cb_data1, pressed_button1, BIT(BUT_Ext1));

	gpio_add_callback(dev, &button_cb_data1);

    
    /*Extern Button2*/
    ret = gpio_pin_interrupt_configure(dev, BUT_Ext2, GPIO_INT_EDGE_TO_ACTIVE | GPIO_INT_DEBOUNCE);

	/*Initialize the static struct gpio_callback variable   */
	gpio_init_callback(&button_cb_data2, pressed_button2, BIT(BUT_Ext2));

	gpio_add_callback(dev, &button_cb_data2);

    
    ret = gpio_pin_interrupt_configure(dev, BUT_Ext3, GPIO_INT_EDGE_TO_ACTIVE | GPIO_INT_DEBOUNCE);

	/*Initialize the static struct gpio_callback variable   */
	gpio_init_callback(&button_cb_data3, pressed_button3, BIT(BUT_Ext3));

	gpio_add_callback(dev, &button_cb_data3);

	
	
	ret = gpio_pin_interrupt_configure(dev, BUT_Ext4, GPIO_INT_EDGE_TO_ACTIVE | GPIO_INT_DEBOUNCE);

	/*Initialize the static struct gpio_callback variable   */
	gpio_init_callback(&button_cb_data4, pressed_button4, BIT(BUT_Ext4));

	gpio_add_callback(dev, &button_cb_data4);




    ret = gpio_pin_interrupt_configure(dev, BUT1, GPIO_INT_EDGE_TO_ACTIVE | GPIO_INT_DEBOUNCE);

	/*Initialize the static struct gpio_callback variable   */
	gpio_init_callback(&button_board_data1, pressed_board_1, BIT(BUT1));

	gpio_add_callback(dev, &button_board_data1);

	ret = gpio_pin_interrupt_configure(dev, BUT2, GPIO_INT_EDGE_TO_ACTIVE | GPIO_INT_DEBOUNCE);

	/*Initialize the static struct gpio_callback variable   */
	gpio_init_callback(&button_board_data2, pressed_board_2, BIT(BUT2));

	gpio_add_callback(dev, &button_board_data2);


	ret = gpio_pin_interrupt_configure(dev, BUT3, GPIO_INT_EDGE_TO_ACTIVE | GPIO_INT_DEBOUNCE);

	/*Initialize the static struct gpio_callback variable   */
	gpio_init_callback(&button_board_data3, pressed_board_3, BIT(BUT3));

	gpio_add_callback(dev, &button_board_data3);


	ret = gpio_pin_interrupt_configure(dev, BUT4, GPIO_INT_EDGE_TO_ACTIVE | GPIO_INT_DEBOUNCE);

	/*Initialize the static struct gpio_callback variable   */
	gpio_init_callback(&button_board_data4, pressed_board_4, BIT(BUT4));

	gpio_add_callback(dev, &button_board_data4);




    return 0;
}

void get_last_event(uint8_t* event_pointer){
    *event_pointer = event;
    event = NONE;
}

uint8_t get_arrow_val(){
    return button_dir;
}

void print(char* string){
    printf("%s", string);
}

void device_sleep(uint32_t ms){
    k_msleep(ms);
}

float get_coin_val(){
    float return_val = coin;
    coin = 0;
    return return_val;
}
```

## src/start_vending_machine.c
```c
#include <stdio.h>
#include "state_machine.h"

int main(){

    if(init_sm() < 0){
        return -1;
    }

    while(1){
        sm_loop();
    }

    return 0;
}
```

## src/state_machine.c
```c
/** @file state_machine.c
 * @brief state_machine.c file brief description
 *
 * State machine state machine implementation file
 * 
 * @date 10 May 2022
 * @bug No known bugs.
 */

#include "state_machine.h"

static uint8_t curr_state;
static uint8_t next_state;
static uint8_t last_event;

uint8_t init_sm(){
    curr_state = STATE_DISPLAY;
    next_state = STATE_DISPLAY;
    last_event = 0;

    return init_drivers();
}

void sm_loop(){
    switch(curr_state){
        case STATE_DISPLAY:
            display_product_money();

            next_state = STATE_DISPLAY;

            get_last_event(&last_event);

            if(last_event == NONE){
                ;
            }else if(last_event == EVENT_SELECT && (get_user_money() >= get_prod_val())){
                next_state = STATE_DISPENSE_PRODUCT;
            }else if(last_event == EVENT_SELECT && (get_user_money() < get_prod_val())){
                next_state = STATE_ERROR_MESSAGE;
            }else if(last_event == EVENT_ARROW){
                next_state = STATE_CHANGE_PRODUCT;
            }else if(last_event == EVENT_RETURN){
                next_state = STATE_RETURN_MONEY;
            }else if(last_event == EVENT_COIN){
                next_state = STATE_COIN_INSERTED;
            }

            break;
        case STATE_RETURN_MONEY:
            return_money();

            next_state = STATE_DISPLAY;
            break;
        case STATE_COIN_INSERTED:
            coin_inserted();

            next_state = STATE_DISPLAY;
            break;
        case STATE_DISPENSE_PRODUCT:
            dispense_prod();

            next_state = STATE_DISPLAY;
            break;
        case STATE_ERROR_MESSAGE:
            error_msg();

            next_state = STATE_DISPLAY;
            break;
        case STATE_CHANGE_PRODUCT:
            cycle_prod();

            next_state = STATE_DISPLAY;
            break;
        default:
            printf("ERROR: Invalid state, possible program error");
            break;
    }

    curr_state = next_state;
}
```

## src/vending_machine.c
```c
/** @file vending_machine.c
 * @brief vending_machine.c file brief description
 *
 * Vending machine state machine implementation file
 * 
 * @date 03 May 2022
 * @bug No known bugs.
 */

#include "vending_machine.h"

// Current selected product index
static uint8_t curr_prod;

// User's money
static float user_val;

uint8_t get_curr_product(){
    return curr_prod;
}

void set_curr_product(uint8_t new_prod){
    curr_prod = new_prod;
}

float get_prod_val(){
    return prices[curr_prod];
}

float get_user_money(){
    return user_val;
}

void set_user_money(float new_val){
    user_val = new_val;
}

void dispense_prod(){
    char string[50];

    sprintf(string, "Dispensing product...\n");

    print(string);

    set_user_money(get_user_money() - get_prod_val());
    device_sleep(5000);
}

void cycle_prod(){
    uint8_t dir = get_arrow_val();

    if(dir == UP){
        set_curr_product((get_curr_product()+1) % NUM_PRODUCTS);
    }else{
        set_curr_product(((get_curr_product() + NUM_PRODUCTS) - 1) % NUM_PRODUCTS);
    }
}

void return_money(){
    char string[50];

    sprintf(string, "Returning %.1f €\n", get_user_money());

    print(string);

    set_user_money(0);
}

void error_msg(){
    char string[50];

    sprintf(string, "The product you want costs %.1f but you only have %.1f\n", get_prod_val(), get_user_money());

    print(string);
}

void display_product_money(){
    char prod_name[50];

    switch(get_curr_product()){
        case BEER:
            strcpy(prod_name, "BEER");
            break;
        case TUNA_SANDWICH:
            strcpy(prod_name, "TUNA_SANDWICH");
            break;
        case COFFEE:
            strcpy(prod_name, "COFFEE");
            break;
    }


    char string[200];

    sprintf(string, "%s: %.1f . You have %.1f     \r", prod_name, get_prod_val(), get_user_money());

    print(string);
}

void coin_inserted(){
    set_user_money(get_user_money() + get_coin_val());
}
```
