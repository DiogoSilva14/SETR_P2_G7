## CMakeLists.txt
```
# SPDX-License-Identifier: Apache-2.0

cmake_minimum_required(VERSION 3.20.0)

find_package(Zephyr REQUIRED HINTS $ENV{ZEPHYR_BASE})
project(hello_world)

target_sources(app PRIVATE src/main.c src/device_drivers.c src/PI_controller.c src/lights_automation.c)
```

## prj.conf
```kconfig
CONFIG_PRINTK=y
CONFIG_HEAP_MEM_POOL_SIZE=256
CONFIG_GPIO=y
CONFIG_TIMING_FUNCTIONS=y
CONFIG_USE_SEGGER_RTT=y
CONFIG_RTT_CONSOLE=n
CONFIG_UART_CONSOLE=y
CONFIG_ADC=y
CONFIG_ADC_ASYNC=y
CONFIG_PWM=y
CONFIG_SERIAL=y
CONFIG_UART_ASYNC_API=y
CONFIG_CBPRINTF_FP_SUPPORT=y
```

## src/main.c
```c
/** @file main.c
 * @brief main implementation
 *
 * Main file for the Lights_Project
 * 
 * @date 20 June 2022
 * @bug No known bugs.
 */
#include <stdlib.h>
#include <stdio.h>
#include "device_drivers.h"
#include "lights_automation.h"

/* Thread code prototypes */
void thread_A_code(void *argA, void *argB, void *argC);
void thread_B_code(void *argA, void *argB, void *argC);
void thread_C_code(void *argA, void *argB, void *argC);

/* PWM Output val */
float pwm_val = 0;

/**
 * @brief Main function
 *
 * Initializes the device drivers, light automation system and the threads. After that the 
 * main function loop is responsible for user interaction with the objective of changing
 * the system behavior and/or tune the system parameters.
 *
 */
void main(void){
	init_drivers();
  init_automation();

	sem_init(SEM_AA, 1, 1);
	sem_init(SEM_AB, 0, 1);
	sem_init(SEM_BC, 0, 1);
    
	thread_create(THREAD_A, thread_A_code);
	thread_create(THREAD_B, thread_B_code);
	thread_create(THREAD_C, thread_C_code);	

  uint32_t print_time;

  while(1){

    print_time = get_uptime();

    print_menu();

    if(uart_rx_rdy()){
      handle_option(get_char());
    }

    if(get_button_press(1)){
      select_auto(true);
    }
    if(get_button_press(2)){
      change_manual(UP);
    }
    if(get_button_press(3)){
      select_auto(false);
    }
    if(get_button_press(4)){
      change_manual(DOWN);
    }

    while(get_uptime() < (print_time + PRINT_PERIOD)){
      sleep_ms(PRINT_PERIOD);
    }

  }

}

/**
 * @brief Thread A code
 * 
 * Thread A is responsible for sampling the ADC value via device drivers
 *
 */
void thread_A_code(void *argA , void *argB, void *argC){
  /* Timing variables to control task periodicity */
  int64_t fin_time=0, release_time=0;

  /* Compute next release instant */
  release_time = get_uptime() + thread_A_period;

  /* Thread loop */
  while(1) {

    adc_sample();

    sem_give(SEM_AB);      

    /* Wait for next release instant */ 
    fin_time = get_uptime();

    if(fin_time < release_time) {
      sleep_ms(release_time - fin_time);
      release_time += thread_A_period;
    }
  }
}

/**
 * @brief Thread B code
 * 
 * Thread B is responsible for getting the PWM output value from the light automation system,
 * which runs the PI controller or the manually changed value.
 *
 */

void thread_B_code(void *argA , void *argB, void *argC){
  /* Thread loop */
  while(1) {
    sem_take(SEM_AB);

    pwm_val = get_value();

    sem_give(SEM_BC);     
  }
}

/**
 * @brief Thread C code
 * 
 * Thread C is responsible for outputting the PWM value.
 *
 */

void thread_C_code(void *argA , void *argB, void *argC){
	/* Thread loop */
  while(1) {
    sem_take(SEM_BC);

    pwm_duty_cycle(pwm_val);
  }
}
```

## src/PI_controller.c
```c
#include "PI_controller.h"

long unsigned int last_ms = 0;
float controller_setpoint = 0;


void PI_init(float setpoint){
    controller_setpoint = setpoint;
    last_ms = get_uptime();
}

float PI_loop(float temp){
    static float last_error = 0;
    static float last_integral = 0;
    
    float error = controller_setpoint - temp;
    
    float delta_ms = (float)(get_uptime()- last_ms);
    last_ms = get_uptime();
    
    float new_integral = last_integral + Ki*(error + last_error)*delta_ms/2;
    
    if(new_integral > 100){
        new_integral = last_integral;
    }else if(new_integral <= 0){
        new_integral = last_integral;
    }
    
    float output = Kp*error + new_integral;
    
    last_integral = new_integral;
    last_error = error;
    
    if(output < 0){
        output = 0;
    }else if(output > 100){
        output = 100;
    }
    
    return output;
}

void PI_change_setpoint(float new_setpoint){
    controller_setpoint = new_setpoint;
}

float get_setpoint(){
    return controller_setpoint;
}
```

## src/PI_controller.h
```c
/** @file PI_controller.h
 * @brief PI controller implementation 
 *
 * This is a library made for the SETR project. This is the PI implementation
 * 
 * @date 20 June 2022
 * @bug No known bugs.
 */
 
#ifndef _PI_H    /* Guard against multiple inclusion */
#define _PI_H

#include <stdio.h>
#include <stdlib.h>
#include <stdint.h>
#include "device_drivers.h"

#define Kp 1
#define Ki 1

/** @brief Initiates the PI with the desired setpoint
 *
 *  @param setpoint Setpoint desired for the PI controller
 */
void PI_init(float setpoint);

/** @brief Calcules the output of the controller for the given input value
 *
 *  @param input_value system output measure for controller
 * 
 *  @return controller output
 */
float PI_loop(float input_value);

/** @brief Changes the setpoint of the PI controller
 *
 *  @param new_setpoint new setpoint for the PI controller
 * 
 */
void PI_change_setpoint(float new_setpoint);

/** @brief Get the current PI controller setpoint
 *
 *  @return current PI setpoint
 * 
 */
float get_setpoint();

#endif
```

## src/device_drivers.c
```c
#include "device_drivers.h"

bool verbose = false;

static struct gpio_callback button_board_data1;
static struct gpio_callback button_board_data2;
static struct gpio_callback button_board_data3;
static struct gpio_callback button_board_data4;

const struct device *adc_dev = NULL;
static uint16_t adc_sample_buffer[ADC_BUFFER_SIZE];

/* ADC channel configuration */
static const struct adc_channel_cfg my_channel_cfg = {
	.gain = ADC_GAIN,
	.reference = ADC_REFERENCE,
	.acquisition_time = ADC_ACQUISITION_TIME,
	.channel_id = ADC_CHANNEL_ID,
	.input_positive = ADC_CHANNEL_INPUT
};

/* Create thread stack space */
K_THREAD_STACK_DEFINE(thread_A_stack, STACK_SIZE);
K_THREAD_STACK_DEFINE(thread_B_stack, STACK_SIZE);
K_THREAD_STACK_DEFINE(thread_C_stack, STACK_SIZE);
  
/* Create variables for thread data */
struct k_thread thread_A_data;
struct k_thread thread_B_data;
struct k_thread thread_C_data;

/* Create task IDs */
k_tid_t thread_A_tid;
k_tid_t thread_B_tid;
k_tid_t thread_C_tid;

/* Semaphores for task synch */
struct k_sem sem_aa;
struct k_sem sem_ab;
struct k_sem sem_bc;

/* Pointer to PWM device structure */
const struct device *pwm0_dev; 

/* Struct for UART configuration (if using default valuies is not needed) */
const struct uart_config uart_cfg = {
		.baudrate = 115200,
		.parity = UART_CFG_PARITY_NONE,
		.stop_bits = UART_CFG_STOP_BITS_1,
		.data_bits = UART_CFG_DATA_BITS_8,
		.flow_ctrl = UART_CFG_FLOW_CTRL_NONE
};

const struct device *uart_dev;          /* Pointer to device struct */ 
static uint8_t rx_buf[RXBUF_SIZE];      /* RX buffer, to store received data */
static uint8_t rx_chars[RXBUF_SIZE];    /* chars actually received  */
volatile int uart_rx_rdy_flag;          /* Flag to signal main() that a message is available */

/* UART callback function prototype */
static void uart_cb(const struct device *dev, struct uart_event *evt, void *user_data);

uint8_t rep_mesg[TXBUF_SIZE];

int err;

bool button_pressed[4];

void pressed_board_1(const struct device *dev, struct gpio_callback *cb, uint32_t pins){
    if(verbose){
        printk("Button 1 pressed\n");
	}

	button_pressed[0] = true;
}

void pressed_board_2(const struct device *dev, struct gpio_callback *cb, uint32_t pins){
	if(verbose){
        printk("Button 2 pressed\n");
	}

	button_pressed[1] = true;
}


void pressed_board_3(const struct device *dev, struct gpio_callback *cb, uint32_t pins){
	if(verbose){
        printk("Button 3 pressed\n");
	}
    
	button_pressed[2] = true;	
}

void pressed_board_4(const struct device *dev, struct gpio_callback *cb, uint32_t pins){
    if(verbose){
        printk("Button 4 pressed\n");
	}
    
    button_pressed[3] = true;
}

uint8_t init_drivers(){
    const struct device *dev;
	int ret;

	dev = device_get_binding(DT_LABEL(GPIO0_NID));  

    // Button configuration

    ret = gpio_pin_configure(dev, BUT1, GPIO_INPUT | GPIO_PULL_UP);
	if (ret < 0) {
		return -1;
	}

	ret = gpio_pin_configure(dev, BUT2, GPIO_INPUT | GPIO_PULL_UP);
	if (ret < 0) {
		return -1;
	}

	ret = gpio_pin_configure(dev, BUT3, GPIO_INPUT | GPIO_PULL_UP);
	if (ret < 0) {
		return -1;
	}


	ret = gpio_pin_configure(dev, BUT4, GPIO_INPUT | GPIO_PULL_UP);
	if (ret < 0) {
		return -1;
	}

    // Button interruption configuration

    ret = gpio_pin_interrupt_configure(dev, BUT1, GPIO_INT_EDGE_TO_ACTIVE | GPIO_INT_DEBOUNCE);

	/*Initialize the static struct gpio_callback variable   */
	gpio_init_callback(&button_board_data1, pressed_board_1, BIT(BUT1));

	gpio_add_callback(dev, &button_board_data1);

	ret = gpio_pin_interrupt_configure(dev, BUT2, GPIO_INT_EDGE_TO_ACTIVE | GPIO_INT_DEBOUNCE);

	/*Initialize the static struct gpio_callback variable   */
	gpio_init_callback(&button_board_data2, pressed_board_2, BIT(BUT2));

	gpio_add_callback(dev, &button_board_data2);


	ret = gpio_pin_interrupt_configure(dev, BUT3, GPIO_INT_EDGE_TO_ACTIVE | GPIO_INT_DEBOUNCE);

	/*Initialize the static struct gpio_callback variable   */
	gpio_init_callback(&button_board_data3, pressed_board_3, BIT(BUT3));

	gpio_add_callback(dev, &button_board_data3);


	ret = gpio_pin_interrupt_configure(dev, BUT4, GPIO_INT_EDGE_TO_ACTIVE | GPIO_INT_DEBOUNCE);

	/*Initialize the static struct gpio_callback variable   */
	gpio_init_callback(&button_board_data4, pressed_board_4, BIT(BUT4));

	gpio_add_callback(dev, &button_board_data4);

    for(int i=0; i<4; i++){
        button_pressed[i] = false;
    }

    init_adc();

	init_uart();

	init_pwm();

    return 0;
}

int adc_sample(void){
	int ret;
	const struct adc_sequence sequence = {
		.channels = BIT(ADC_CHANNEL_ID),
		.buffer = adc_sample_buffer,
		.buffer_size = sizeof(adc_sample_buffer),
		.resolution = ADC_RESOLUTION,
	};

	if (adc_dev == NULL) {
            printk("adc_sample(): error, must bind to adc first \n\r");
            return -1;
	}

	ret = adc_read(adc_dev, &sequence);
	if (ret) {
            printk("adc_read() failed with code %d\n", ret);
	}	

	return ret;
}

uint16_t get_adc_buffer(){
	return adc_sample_buffer[0];
}

void init_adc(){
	int err = 0;

	adc_dev = device_get_binding(DT_LABEL(ADC_NID));
	if (!adc_dev) {
        printk("ADC device_get_binding() failed\n");
    } 
    err = adc_channel_setup(adc_dev, &my_channel_cfg);
    if (err) {
        printk("adc_channel_setup() failed with error code %d\n", err);
    }

	/* It is recommended to calibrate the SAADC at least once before use, and whenever the ambient temperature has changed by more than 10 °C */
    NRF_SAADC->TASKS_CALIBRATEOFFSET = 1;
}

int init_pwm(){
	/* Bind to PWM */
	pwm0_dev = device_get_binding(DT_LABEL(PWM0_NID));	
    if (pwm0_dev == NULL) {
		printk("Error: Failed to bind to PWM0\n r");
		return -1;
    }else{
		if(verbose){
			printk("Bind to PWM0 successful\n\r"); 
		}

		return 0;       
    }
}

void pwm_duty_cycle(float new_duty_cycle){
	if(verbose){
		printk("DUTY_CYCLE: %d \r", (int)(100 - new_duty_cycle));
	}

	int ret;

	/* Apply the PWM signal and indicate the error in case there is any */
	ret = pwm_pin_set_usec(pwm0_dev, PWM_OUTPUT_PIN,
		PWM_PERIOD_USEC,(unsigned int)((PWM_PERIOD_USEC*(unsigned int)(100 - new_duty_cycle))/100), PWM_POLARITY_NORMAL);

	if(ret){
		printk("Error %d setting PWM\n", ret);
	}
}

bool get_button_press(uint8_t button_num){
	uint8_t val = button_pressed[button_num - 1];

	button_pressed[button_num - 1] = false;

	return val;
}

bool button_rdy(){
	return button_pressed[0] || button_pressed[1] || button_pressed[2] || button_pressed[3];
}

int64_t get_uptime(){
	return k_uptime_get();
}

void sleep_ms(int32_t ms){
	k_msleep(ms);
}

int sem_init(uint8_t semaph, uint8_t start_val, uint8_t max_val){
	if(semaph == SEM_AA){
		return k_sem_init(&sem_aa, start_val, max_val);
	}else if(semaph == SEM_AB){
		return k_sem_init(&sem_ab, start_val, max_val);
	}else if(semaph == SEM_BC){
		return k_sem_init(&sem_bc, start_val, max_val);
	}
	
	return -1;
}

void sem_give(uint8_t semaph){
	if(semaph == SEM_AA){
		k_sem_give(&sem_aa);
	}else if(semaph == SEM_AB){
		k_sem_give(&sem_ab);
	}else if(semaph == SEM_BC){
		k_sem_give(&sem_bc);
	}
}

int sem_take(uint8_t semaph){
	if(semaph == SEM_AA){
		return k_sem_take(&sem_aa,  K_FOREVER);
	}else if(semaph == SEM_AB){
		return k_sem_take(&sem_ab,  K_FOREVER);
	}else if(semaph == SEM_BC){
		return k_sem_take(&sem_bc,  K_FOREVER);
	}

	return -1;
}

void thread_create(uint8_t thread_num, void (*fun)()){
	if(thread_num == THREAD_A){
		k_thread_create(&thread_A_data, thread_A_stack,
			K_THREAD_STACK_SIZEOF(thread_A_stack), fun,
			NULL, NULL, NULL, thread_A_prio, 0, K_NO_WAIT);
	}else if(thread_num == THREAD_B){
		k_thread_create(&thread_B_data, thread_B_stack,
			K_THREAD_STACK_SIZEOF(thread_B_stack), fun,
			NULL, NULL, NULL, thread_B_prio, 0, K_NO_WAIT);
	}else if(thread_num == THREAD_C){
		k_thread_create(&thread_C_data, thread_C_stack,
			K_THREAD_STACK_SIZEOF(thread_C_stack), fun,
			NULL, NULL, NULL, thread_B_prio, 0, K_NO_WAIT);
	}
}

void init_uart(){
	/* Bind to UART */
	uart_dev= device_get_binding(DT_LABEL(UART_NID));
    if (uart_dev == NULL) {
        printk("device_get_binding() error for device %s!\n\r", DT_LABEL(UART_NID));
        return;
    }

	/* Configure UART */
    err = uart_configure(uart_dev, &uart_cfg);
    if (err == -ENOSYS) { /* If invalid configuration */
        printk("uart_configure() error. Invalid configuration\n\r");
        return; 
    }	

	/* Register callback */
    err = uart_callback_set(uart_dev, uart_cb, NULL);
    if (err) {
        printk("uart_callback_set() error. Error code:%d\n\r",err);
        return;
    }

	/* Enable data reception */
    err =  uart_rx_enable(uart_dev ,rx_buf,sizeof(rx_buf),RX_TIMEOUT);
    if (err) {
        printk("uart_rx_enable() error. Error code:%d\n\r",err);
        return;
    }
}

/* UART callback implementation */
/* Note that callback functions are executed in the scope of interrupt handlers. */
/* They run asynchronously after hardware/software interrupts and have a higher priority than all threads */
/* Should be kept as short and simple as possible. Heavier processing should be deferred to a task with suitable priority*/
static void uart_cb(const struct device *dev, struct uart_event *evt, void *user_data){

	switch (evt->type) {
		
		case UART_TX_DONE:
			//printk("UART_TX_DONE event \n\r");
			break;

		case UART_TX_ABORTED:
			//printk("UART_TX_ABORTED event \n\r");
			break;
			
		case UART_RX_RDY:
			//printk("UART_RX_RDY event \n\r");
					/* Just copy data to a buffer. Usually it is preferable to use e.g. a FIFO to communicate with a task that shall process the messages*/
					memcpy(rx_chars,&(rx_buf[evt->data.rx.offset]),evt->data.rx.len); 
					rx_chars[evt->data.rx.len]=0; /* Terminate the string */
					uart_rx_rdy_flag = 1;
			break;

		case UART_RX_BUF_REQUEST:
			//printk("UART_RX_BUF_REQUEST event \n\r");
			break;

		case UART_RX_BUF_RELEASED:
			//printk("UART_RX_BUF_RELEASED event \n\r");
			break;
			
		case UART_RX_DISABLED: 
					/* When the RX_BUFF becomes full RX is is disabled automaticaly.  */
					/* It must be re-enabled manually for continuous reception */
					//printk("UART_RX_DISABLED event \n\r");
			err =  uart_rx_enable(uart_dev ,rx_buf,sizeof(rx_buf),RX_TIMEOUT);
					if (err) {
						printk("uart_rx_enable() error. Error code:%d\n\r",err);              
					}
			break;

		case UART_RX_STOPPED:
			//printk("UART_RX_STOPPED event \n\r");
			break;
			
		default:
			printk("UART: unknown event \n\r");
			break;
	}
}

bool uart_rx_rdy(){
	if(uart_rx_rdy_flag){
		uart_rx_rdy_flag = 0;
		return true;
	}else{
		return false;
	}
}

char get_char(){
	return rx_buf[0];
}
```

## src/device_drivers.h
```c
/** @file device_drivers.h
 * @brief Device Drivers implementation
 *
 * This is a library made for the SETR project. It is respnsible for the innitialization of the drivers
 * 
 * @date 20 June 2022
 * @bug No known bugs.
 */
 
#ifndef _DEVICE_DRIVERS_H    /* Guard against multiple inclusion */
#define _DEVICE_DRIVERS_H

#include <zephyr.h>
#include <device.h>
#include <drivers/gpio.h>
#include <drivers/pwm.h>
#include <drivers/adc.h>
#include <sys/printk.h>
#include <sys/__assert.h>
#include <string.h>
#include <timing/timing.h>
#include <stdlib.h>
#include <stdio.h>
#include "nrfx_pwm.h"
#include <drivers/pwm.h>
#include <hal/nrf_saadc.h>
#include <drivers/uart.h>

#define GPIO0_NID DT_NODELABEL(gpio0)

// Buttons used
#define BUT1 11
#define BUT2 12
#define BUT3 24
#define BUT4 25

/*ADC definitions and includes*/
#define ADC_NID DT_NODELABEL(adc) 
#define ADC_RESOLUTION 10
#define ADC_GAIN ADC_GAIN_1_4
#define ADC_REFERENCE ADC_REF_VDD_1_4
#define ADC_ACQUISITION_TIME ADC_ACQ_TIME(ADC_ACQ_TIME_MICROSECONDS, 40)
#define ADC_CHANNEL_ID 1  

/* This is the actual nRF ANx input to use. Note that a channel can be assigned to any ANx. In fact a channel can */
/*    be assigned to two ANx, when differential reading is set (one ANx for the positive signal and the other one for the negative signal) */  
/* Note also that the configuration of differnt channels is completely independent (gain, resolution, ref voltage, ...) */
#define ADC_CHANNEL_INPUT NRF_SAADC_INPUT_AIN1 
#define ADC_BUFFER_SIZE 1

#define PWM0_NID DT_NODELABEL(pwm0)
#define PWM_OUTPUT_PIN 13
#define PWM_PERIOD_USEC 1000

/* Size of stack area used by each thread (can be thread specific, if necessary)*/
#define STACK_SIZE 1024

/* Thread scheduling priority */
#define thread_A_prio 1
#define thread_B_prio 1
#define thread_C_prio 1

/* Therad periodicity (in ms)*/
#define thread_A_period 100

#define UART_NID DT_NODELABEL(uart0)    /* UART Node label, see dts */
#define RXBUF_SIZE 1                   /* RX buffer size */
#define TXBUF_SIZE 60                   /* TX buffer size */
#define RX_TIMEOUT 1000                  /* Inactivity period after the instant when last char was received that triggers an rx event (in us) */

#define SEM_AA 1
#define SEM_AB 2
#define SEM_BC 3

#define THREAD_A 1
#define THREAD_B 2
#define THREAD_C 3

/** 
 * @brief Callback function for button 1 press
 */
void pressed_board_1(const struct device *dev, struct gpio_callback *cb, uint32_t pins);

/** 
 * @brief Callback function for button 2 press
 */
void pressed_board_2(const struct device *dev, struct gpio_callback *cb, uint32_t pins);

/** 
 * @brief Callback function for button 3 press
 */
void pressed_board_3(const struct device *dev, struct gpio_callback *cb, uint32_t pins);

/** 
 * @brief Callback function for button 4 press
 */
void pressed_board_4(const struct device *dev, struct gpio_callback *cb, uint32_t pins);

/** 
 * @brief Indicates if any button has been pressed
 * 
 * @return bool indicating if any button has been pressed
 */
bool button_rdy();

/** 
 * @brief Function responsible for initializing everything associated with the device drivers
 * like data structures and binds
 * 
 * @return error number in case of any problem initializing. 0 if successful
 */
uint8_t init_drivers();

/** 
 * @brief Samples a value from the ADC
 * 
 * @return error code in case of error sampling from ADC. 0 if successful
 */
int adc_sample(void);

/** 
 * @brief Gets the value samples from the ADC
 * 
 * @return value sampled by the ADC
 */
uint16_t get_adc_buffer();

/** 
 * @brief Initializes the ADC
 */
void init_adc();

/** 
 * @brief Initializes the PWM module
 * 
 * @return error code in case theres any, 0 if successful
 */
int init_pwm();

/** 
 * @brief Change the PWM output duty cycle
 * 
 * @param new_duty_cycle New duty cycle to be outputed by the PWM module
 */
void pwm_duty_cycle(float new_duty_cycle);

/** 
 * @brief Indicates if the specified button has been pressed
 * 
 * @param button_num button to get press
 * 
 * @return boolean indicated if the speficied button has been pressed or not
 */
bool get_button_press(uint8_t button_num);

/** 
 * @brief Get the microcontroller uptime in miliseconds
 * 
 * @return uptime in miliseconds
 */
int64_t get_uptime();

/** 
 * @brief Sleeps for the amount specified
 * 
 * @param ms miliseconds to sleep
 */
void sleep_ms(int32_t ms);

/** 
 * @brief Initialize the specified semaphores with the specified values
 * 
 * @param semaph Semaphore to be initialized. Use SEM_AA, SEM_AB and SEM_BC defines.
 * @param start_val Starting value of the semaphore
 * @param max_val Maximum value of the semaphore
 */
int sem_init(uint8_t semaph, uint8_t start_val, uint8_t max_val);

/** 
 * @brief Increments the specified semaphore
 * 
 * @param semaph Semaphore to be incremented. Use SEM_AA, SEM_AB and SEM_BC defines.
 */
void sem_give(uint8_t semaph);

/** 
 * @brief Take the specified semaphore
 * 
 * @param semaph Semaphore to be taken. Use SEM_AA, SEM_AB and SEM_BC defines.
 */
int sem_take(uint8_t semaph);

/** 
 * @brief Creates the specified semaphore
 * 
 * @param thread_num Thread to be created. Use THREAD_A, THREAD_B and THREAD_C defines.
 * @param fun function for the thread to run
 */
void thread_create(uint8_t thread_num, void (*fun)());

/** 
 * @brief Initialize UART module
 */
void init_uart();

/** 
 * @brief Indicates if the UART has characters ready to be received
 * 
 * @return bool indicating if there are characters to be read
 */
bool uart_rx_rdy();

/** 
 * @brief Gets the last character read by the UART
 * 
 * @return Last character read by the uart
 */
char get_char();

/** 
 * @brief UART RX callback
 */
static void uart_cb(const struct device *dev, struct uart_event *evt, void *user_data);

#endif
```

## src/lights_automation.c
```c
#include "lights_automation.h"

uint8_t auto_values[24];
uint8_t current_hour;
bool auto_state = false;
float manual_pwm_vals[] = {0, 25, 50, 75, 100};
int8_t pwm_head = 0;
float controller_out = 0;

void init_automation(){
    for(int i=0; i < 24; i++){
        auto_values[i] = i*4; // test vals
    }

    current_hour = 0;

    PI_init(auto_values[current_hour]);
}

float get_value(){
    if(auto_state){
        controller_out = PI_loop(((float)get_adc_buffer()-200)/8);
        return controller_out;
    }else{
        return manual_pwm_vals[pwm_head]; 
    }
}

void print_menu(){
    printf("\033[2J\033[;H. \033[2J");
    printf("\033[;H");
    printf("====================\n");
    printf(" MODE: ");
    if(auto_state){
        printf("AUTO\n");
    }else{
        printf("MANUAL\n");
    }
    printf(" PWM: %f \n", get_value());
    printf(" ADC: %d\n", get_adc_buffer());
    printf(" DIODE VAL: %f\n", ((float)get_adc_buffer()-200)/8);
    printf(" SETPOINT: %f\n", get_setpoint());
    printf(" CONTROLLER OUT: %f\n", controller_out);
    printf(" Current Hour: %d \n", current_hour);
    printf(" 1 - Show table\n");
    printf(" 2 - Change value\n");
    printf(" 3 - Change hour\n");
    printf(" Select option: ");
}

void handle_option(uint8_t option){
    uint8_t new_hour = 0;

    switch(option){
        case '1':
            printf("====================\n");
            printf("HOUR | VALUE\n");

            for(int i=0; i < 24; i++){
                printf(" %d : %d \n", i, auto_values[i]);
            }

            printf("Press ENTER to continue \n");

            while(!(uart_rx_rdy() && get_char() == '\r')){
                sleep_ms(PRINT_PERIOD);
            }

            break;
        case '2':
            printf("Hour to change: \n");
            
            uint8_t hour_to_change = 0;

            char pressed = 'a';

            while(pressed != '\r'){
                printf("\r%d  ", hour_to_change);

                if(uart_rx_rdy()){
                    pressed = get_char();
                    if(pressed == 'u'){
                        hour_to_change++;
                    }else if(pressed == 'd'){
                        hour_to_change--;
                    }
                }

                if(hour_to_change < 0){
                    hour_to_change = 23;
                }else if(hour_to_change > 23){
                    hour_to_change = 0;
                }

                sleep_ms(PRINT_PERIOD);
            }

            printf("\nCurrent value: %d. New value ? \n", auto_values[hour_to_change]);

            int new_val = 0;

            pressed = 'a';

            while(pressed != '\r'){
                printf("\r%d  ", new_val);

                if(uart_rx_rdy()){
                    pressed = get_char();

                    if(pressed == 'u'){
                        new_val = new_val + 1;
                    }else if(pressed == 'd'){
                        new_val = new_val - 1;
                    }
                }

                if(new_val < 0){
                    new_val = 0;
                }else if(hour_to_change > 100){
                    new_val = 100;
                }

                sleep_ms(PRINT_PERIOD);
            }

            auto_values[hour_to_change] = new_val;

            printf("Value changed successfully!\n");
            printf("Press ENTER to continue \n");

            while(!(uart_rx_rdy() && get_char() == '\r')){
                sleep_ms(PRINT_PERIOD);
            }

            break;
        case '3':
            printf("Current hour: %d. New hour? \n", current_hour);

            pressed = 'a';

            while(pressed != '\r'){
                printf("\r%d  ", new_hour);

                if(uart_rx_rdy()){
                    pressed = get_char();
                    if(pressed == 'u'){
                        new_hour++;
                    }else if(pressed == 'd'){
                        new_hour--;
                    }
                }

                if(new_hour < 0){
                    new_hour = 23;
                }else if(new_hour > 23){
                    new_hour = 0;
                }

                sleep_ms(PRINT_PERIOD);
            }

            current_hour = new_hour;

            PI_change_setpoint(auto_values[current_hour]);

            printf("Value changed successfully!\n");
            printf("Press ENTER to continue \n");

            while(!(uart_rx_rdy() && get_char() == '\r')){
                sleep_ms(PRINT_PERIOD);
            }

            break;

        default:
            printf("ERROR: Option not available\n");
            break;
    }

    PI_change_setpoint(auto_values[current_hour]);
}

void select_auto(bool option){
    auto_state = option;
    PI_change_setpoint(auto_values[current_hour]);
}

void change_manual(uint8_t direction){
    if(direction == UP){
        pwm_head++;
    }else{
        pwm_head--;
    }

    if(pwm_head > 4){
        pwm_head = 4;
    }else if(pwm_head < 0){
        pwm_head = 0;
    }
}
```

## src/lights_automation.h
```c
/** @file lights_automation.h
 * @brief Device Drivers implementation
 *
 * This is a library made for the SETR project. It is respnsible for the control of the automatic mode
 * 
 * @date 20 June 2022
 * @bug No known bugs.
 */
 
#ifndef _LIGHTS_AUTO_H    /* Guard against multiple inclusion */
#define _LIGHTS_AUTO_H

#include <stdio.h>
#include <stdlib.h>
#include <stdint.h>
#include "PI_controller.h"

/* Defines for the direction of PWM change when in manual mode */
#define UP 1
#define DOWN 2
/* Period of sleep between while loops */
#define PRINT_PERIOD 100

/**
 * @brief Initializes the variables for automation and the PI controller
 *
 */
void init_automation();

/**
 * @brief Get the PWM output value for the system. This value is gotten either
 * from the array of predefined values that the user can scroll through or the
 * PI controller.
 *
 * @return PWM duty cycle
 */
float get_value();

/**
 * @brief Print the menu with system statistics and user interaction via UART
 *
 */
void print_menu();

/**
 * @brief Handle the options inputted by the user via UART. This function blocks 
 * while the user is choosing the parameters to change but includes some delays
 * to prevent the other threads from not running.
 *
 */
void handle_option(uint8_t option);

/**
 * @brief Change between the automatic mode and the manual mode.
 * 
 * @param option true to put the system in automatic mode and false to put the
 * system in manual mode
 *
 */
void select_auto(bool option);

/**
 * @brief Change between the predefined PWM output values
 * 
 * @param direction indicates the direction in which the PWM output value
 * should change, either up or down. Use the UP and DOWN defines to change.
 *
 */
void change_manual(uint8_t direction);

#endif
```
